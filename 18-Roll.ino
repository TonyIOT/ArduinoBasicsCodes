/*
   Roll
   点阵屏流动显示
*/
int leds[8] = {6, 11, 5, 9, 14, 4, 15, 2}; //点阵屏正极引脚
int gnds[8] = {10, 16, 17, 7, 3, 8, 12, 13}; //点阵屏负极引脚

//字库
char test[] = {
  0x00, 0x7C, 0x8A, 0x92, 0xA2, 0x7C, 0x00, 0x00, // -0-
  0x00, 0x00, 0x42, 0xFE, 0x02, 0x00, 0x00, 0x00, // -1-
  0x00, 0x46, 0x8A, 0x92, 0x92, 0x62, 0x00, 0x00, // -2-
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  0x00, 0xFE, 0x90, 0x90, 0x90, 0x80, 0x00, 0x00, // -F-

};

void setup() {
  for (int i = 0; i < 8; i++)
  {
    pinMode(leds[i], OUTPUT);
    pinMode(gnds[i], OUTPUT);
    digitalWrite(gnds[i], HIGH); //负极引脚拉高，熄灭所有LED
  }
}

void ledclean()
{
  for (int i = 0; i < 8; i++)//将点阵屏正极ladies，负极拉高，关断显示
  {
    digitalWrite(leds[i], LOW);
    digitalWrite(gnds[i], HIGH);
  }
}

//字符显示
void ledShow(char num, char dat)
{
  digitalWrite(gnds[num], LOW);
  for (int i = 0; i < 8; i++)
  {
    digitalWrite(leds[i], dat & 0x80); // 1 0 0 0 0 0 0 0
    dat <<= 1;
  }
  delayMicroseconds(100);
  digitalWrite(gnds[num], HIGH);
  ledclean();
}

void loop() {

  for (int a = 0; a < 120; a++) //控制流动显示内容
  {
    for (int i = 0 ; i < 200 ; i++)//循环显示达到延时效果
    {
      for (int c = 0; c < 8; c++) //8列循环扫描，达到点阵屏驱动效果
      {
        ledShow(c, test[c + a]);
      }
    }
  }

}

